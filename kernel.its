## kernel.its
```
/*
 * FIT image for the NanoKVM-Go: Linux (Image.gz), its device tree and TF-A's
 * BL31, which U-Boot's go64 enters in AArch64. U-Boot verifies the hashes
 * before booting; a damaged slot then fails over to the other one.
 */
/dts-v1/;

/ {
	description = "NanoKVM-Go Linux";
	#address-cells = <1>;

	images {
		kernel {
			description = "Linux Image";
			data = /incbin/("Image.gz");
			type = "kernel";
			arch = "arm64";
			os = "linux";
			compression = "gzip";
			load = <0x40200000>;
			entry = <0x40200000>;
			hash {
				algo = "sha256";
			};
		};

		fdt {
			description = "NanoKVM-Go device tree";
			data = /incbin/("ax620qe-nanokvm-go.dtb");
			type = "flat_dt";
			arch = "arm64";
			compression = "none";
			hash {
				algo = "sha256";
			};
		};

		bl31 {
			description = "TF-A BL31";
			data = /incbin/("bl31.bin");
			type = "firmware";
			arch = "arm64";
			os = "arm-trusted-firmware";
			compression = "none";
			load = <0x40040000>;
			entry = <0x40040000>;
			hash {
				algo = "sha256";
			};
		};
	};

	configurations {
		default = "nanokvm-go";

		nanokvm-go {
			description = "NanoKVM-Go";
			kernel = "kernel";
			fdt = "fdt";
			firmware = "bl31";
		};
	};
};
```
